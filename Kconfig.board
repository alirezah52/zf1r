## Kconfig.board
```kconfig
# ZINOTEK board configuration

# Copyright (c) 2021 The ZMK Contributors
# SPDX-License-Identifier: MIT

config BOARD_ZF1R
    	bool "ZF1R"
    	depends on SOC_NRF52840_QIAA   
```

## Kconfig.defconfig
```kconfig
# Copyright (c) 2021 The ZMK Contributors
# SPDX-License-Identifier: MIT

if BOARD_ZF1R

config ZMK_KEYBOARD_NAME   
        default "ZF1R"

if USB

config USB_NRFX
	    default y

config USB_DEVICE_STACK
         default y

endif # USB

config BT_CTLR
	    default BT

config ZMK_BLE
	    default y

config ZMK_USB
	    default y


#CONFIG_ZMK_USB_LOGGING=y
#config ZMK_BATTERY_VOLTAGE_DIVIDER


endif # BOARD_LARSIAN
```
